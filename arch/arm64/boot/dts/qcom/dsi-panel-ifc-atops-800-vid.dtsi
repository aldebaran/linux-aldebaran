/* Copyright (c) 2014-2015, The Linux Foundation. All rights reserved.
 *
 * This program is free software; you can redistribute it and/or modify
 * it under the terms of the GNU General Public License version 2 and
 * only version 2 as published by the Free Software Foundation.
 *
 * This program is distributed in the hope that it will be useful,
 * but WITHOUT ANY WARRANTY; without even the implied warranty of
 * MERCHANTABILITY or FITNESS FOR A PARTICULAR PURPOSE.  See the
 * GNU General Public License for more details.
 */
 /* ATOPS dsi panel for IFC prducts.
 *
 * Inforce Computing
 */
&mdss_mdp {
	dsi_ifc_atops_800_vid:qcom,mdss_dsi_ifc_atops_800_vid {
		qcom,mdss-dsi-panel-name = "IFC Atops DSI Video Panel 800x1280";
		qcom,mdss-dsi-panel-controller = <&mdss_dsi0>;
		qcom,mdss-dsi-bpp = <24>;
		qcom,mdss-dsi-panel-type = "dsi_video_mode";
                qcom,mdss-dsi-virtual-channel-id = <0>;
                qcom,mdss-dsi-stream = <0>;
                qcom,mdss-dsi-h-left-border = <0>;
                qcom,mdss-dsi-h-right-border = <0>;
                qcom,mdss-dsi-v-top-border = <0>;
                qcom,mdss-dsi-v-bottom-border = <0>;
                qcom,mdss-dsi-color-order = "rgb_swap_rgb";
                qcom,mdss-dsi-underflow-color = <0xff>;
                qcom,mdss-dsi-border-color = <0>;
                qcom,mdss-dsi-traffic-mode = "non_burst_sync_pulse";
                qcom,mdss-dsi-bllp-eof-power-mode;
                qcom,mdss-dsi-bllp-power-mode;
                qcom,mdss-dsi-lane-0-state;
                qcom,mdss-dsi-lane-1-state;
                qcom,mdss-dsi-lane-2-state;
                qcom,mdss-dsi-lane-3-state;
                qcom,mdss-dsi-bl-min-level = <1>;
                qcom,mdss-dsi-bl-max-level = <4095>;
                qcom,mdss-pan-physical-width-dimension = <150>;
                qcom,mdss-pan-physical-height-dimension = <94>;
                qcom,mdss-dsi-dma-trigger = "trigger_sw";
                qcom,mdss-dsi-mdp-trigger = "none";
                qcom,mdss-dsi-panel-timings = [1E 0D 03 05 02 1E 1B 04 05 02 02 04];
                qcom,mdss-dsi-t-clk-post = <0x0a>;
                qcom,mdss-dsi-t-clk-pre = <0x1c>;
                qcom,mdss-dsi-reset-sequence = <1 10>, <0 20>, <1 10>;
                qcom,mdss-dsi-lp11-init;
                qcom,mdss-dsi-init-delay-us = <500>;

		qcom,mdss-dsi-display-timings {
		    timing@0 {
			qcom,mdss-dsi-panel-width = <800>;
			qcom,mdss-dsi-panel-height = <1280>;
			qcom,mdss-dsi-h-front-porch = <20>;
			qcom,mdss-dsi-h-back-porch = <20>;
			qcom,mdss-dsi-v-front-porch = <8>;
			qcom,mdss-dsi-v-back-porch = <8>;
			qcom,mdss-dsi-h-pulse-width = <12>;
			qcom,mdss-dsi-v-pulse-width = <4>;
			qcom,mdss-dsi-h-sync-skew = <0>;
			qcom,mdss-dsi-h-sync-pulse = <1>;
			qcom,mdss-dsi-panel-framerate = <60>;
			qcom,mdss-dsi-on-command = [	29 01 00 00 00 00 02 50 77
			29 01 00 00 00 00 02 e1 66
			29 01 00 00 00 00 02 dc 67
			29 01 00 00 00 00 02 50 00
			29 01 00 00 00 00 02 57 88
			29 01 00 00 00 00 02 be 1a
			29 01 00 00 00 00 02 bf 02
			29 01 00 00 00 00 02 c0 82
			29 01 00 00 00 00 02 c1 03
			29 01 00 00 00 00 02 c3 02
			29 01 00 00 00 00 02 da 1a
			29 01 00 00 00 00 02 db 02
			29 01 00 00 00 00 02 dc 82
			29 01 00 00 00 00 02 dd 0b
			29 01 00 00 00 00 02 de 08
			29 01 00 00 00 00 02 df 03
			29 01 00 00 00 00 02 f2 12
			29 01 00 00 00 00 02 f3 14
			29 01 00 00 00 00 02 b7 02
			29 01 00 00 00 00 02 57 00
			29 01 00 00 00 00 02 58 33
			29 01 00 00 00 00 02 9e 90
			29 01 00 00 00 00 02 9f 24
			29 01 00 00 00 00 02 c5 c2
			29 01 00 00 00 00 02 cf d8
			29 01 00 00 00 00 02 d2 76
			29 01 00 00 00 00 02 58 00
			29 01 00 00 00 00 03 f0 5a 5a
			29 01 00 00 00 00 04 f5 81 37 40
			29 01 00 00 00 00 08 f7 16 16 1a 1a 18 18 19
			29 01 00 00 00 00 02 b0 07
			29 01 00 00 00 00 08 f7 19 08 08 0a 0a 0c 0c
			29 01 00 00 00 00 02 b0 0e
			29 01 00 00 00 00 08 f7 0e 0e 0f 0f 0d 0d 0b
			29 01 00 00 00 00 02 b0 15
			29 01 00 00 00 00 08 f7 0b 09 09 19 19 18 18
			29 01 00 00 00 00 02 b0 1c
			29 01 00 00 00 00 05 f7 1a 1a 17 17
			29 01 00 00 00 00 08 fa 29 1a 2b 24 29 2c 2a
			29 01 00 00 00 00 02 b0 07
			29 01 00 00 00 00 08 fa 27 29 29 36 2a 2e 38
			29 01 00 00 00 00 02 b0 0e
			29 01 00 00 00 00 04 fa 35 35 19
			29 01 00 00 00 00 08 fb 22 13 24 1b 1e 25 29
			29 01 00 00 00 00 02 b0 07
			29 01 00 00 00 00 08 fb 2e 21 31 37 2d 31 2f
			29 01 00 00 00 00 02 b0 0e
			29 01 00 00 00 00 04 fb 29 2c 12
			15 01 00 00 00 00 02 53 24
			05 01 00 00 00 00 01 11
			05 01 00 00 00 00 01 29];
			qcom,mdss-dsi-off-command = [05 01 00 00 00 00 01 10
					05 01 00 00 00 00 01 28
					05 01 00 00 00 00 02 53 00 ];
			qcom,mdss-dsi-on-command-state = "dsi_lp_mode";
			qcom,mdss-dsi-off-command-state = "dsi_lp_mode";
			};
		};
	};
};
