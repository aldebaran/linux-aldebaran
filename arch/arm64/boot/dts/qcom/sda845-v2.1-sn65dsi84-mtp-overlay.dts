/* Copyright (c) 2017, The Linux Foundation. All rights reserved.
 *
 * This program is free software; you can redistribute it and/or modify
 * it under the terms of the GNU General Public License version 2 and
 * only version 2 as published by the Free Software Foundation.
 *
 * This program is distributed in the hope that it will be useful,
 * but WITHOUT ANY WARRANTY; without even the implied warranty of
 * MERCHANTABILITY or FITNESS FOR A PARTICULAR PURPOSE.  See the
 * GNU General Public License for more details.
 */


/dts-v1/;
/plugin/;

#include <dt-bindings/clock/qcom,gcc-sdm845.h>
#include <dt-bindings/clock/qcom,camcc-sdm845.h>
#include <dt-bindings/clock/qcom,dispcc-sdm845.h>
#include <dt-bindings/clock/qcom,rpmh.h>
#include <dt-bindings/interrupt-controller/arm-gic.h>

#include "sdm845-sde-display.dtsi"
#include "sdm845-mtp.dtsi"
#include "sdm845-audio-overlay.dtsi"

/ {
	model = "Qualcomm Technologies, Inc. sda845 v2.1 BRIDGE Mipi/LVDS MTP";
	compatible = "qcom,sda845-mtp", "qcom,sda845", "qcom,mtp";
	qcom,msm-id = <341 0x20001>;
	qcom,board-id = <8 3>;
};

&qupv3_se5_i2c {
	dsi_lvds_bridge: sn65dsi84@2c {
		compatible = "ti,sn65dsi84";
		reg = <0x2c>;
		status = "okay";
		enable-gpios = <&tlmm 1 0x00>;
		sn65dsi84,addresses = < 0x09 0x0A 0x0B 0x0D 0x10 0x11 0x12 0x13
			                0x18 0x19 0x1A 0x1B 0x20 0x21 0x22 0x23
			                0x24 0x25 0x26 0x27 0x28 0x29 0x2A 0x2B
			                0x2C 0x2D 0x2E 0x2F 0x30 0x31 0x32 0x33
			                0x34 0x35 0x36 0x37 0x38 0x39 0x3A 0x3B
			                0x3C 0x3D 0x3E 0x0D>;
		sn65dsi84,values =    < 0x00 0x05 0x10 0x00 0x26 0x00 0x2B 0x00
			                0x58 0x05 0x03 0x00 0x20 0x03 0x00 0x00
			                0x00 0x00 0x00 0x00 0x21 0x00 0x00 0x00
			                0x18 0x00 0x00 0x00 0x03 0x00 0x00 0x00
			                0x38 0x00 0x14 0x00 0x50 0x00 0x00 0x00
			                0x00 0x00 0x00 0x01>;
	};
};
